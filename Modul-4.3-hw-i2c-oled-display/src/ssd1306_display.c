#include "ssd1306_display.h"
#include <string.h>
#include "driver/i2c_master.h"
#include "esp_lcd_panel_io.h"
#include "esp_lcd_panel_vendor.h"
#include "esp_lcd_panel_ops.h"
#include "esp_log.h"

static const char *TAG = "SSD1306_DRIVER";

// Внутрішній фреймбуфер (1024 байти)
static uint8_t oled_buffer[1024];

// Дескриптор панелі дисплея
static esp_lcd_panel_handle_t panel_handle = NULL;

// Таблиця шрифту 5x8
static const uint8_t font_5x8[][5] = {
    {0x00, 0x00, 0x00, 0x00, 0x00}, // ' ' (32)
    {0x00, 0x00, 0x5F, 0x00, 0x00}, // '!'
    {0x00, 0x07, 0x00, 0x07, 0x00}, // '"'
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    {0x44, 0x64, 0x54, 0x4C, 0x44}, // 'z'
};

static uint8_t expand_nibble(uint8_t nibble)
{
    uint8_t res = 0;
    if (nibble & 0x01) res |= 0x03;
    if (nibble & 0x02) res |= 0x0C;
    if (nibble & 0x04) res |= 0x30;
    if (nibble & 0x08) res |= 0xC0;
    return res;
}

esp_err_t ssd1306_display_init(void)
{
    ESP_LOGI(TAG, "Ініціалізація I2C шини...");
    i2c_master_bus_config_t i2c_bus_config = {
        .clk_source = I2C_CLK_SRC_DEFAULT,
        .i2c_port = I2C_BUS_PORT,
        .scl_io_num = PIN_NUM_SCL,
        .sda_io_num = PIN_NUM_SDA,
        .glitch_ignore_cnt = 7,
        .flags.enable_internal_pullup = true,
    };
    i2c_master_bus_handle_t bus_handle = NULL;
    ESP_ERROR_CHECK(i2c_new_master_bus(&i2c_bus_config, &bus_handle));

    ESP_LOGI(TAG, "Ініціалізація панелі SSD1306...");
    esp_lcd_panel_io_handle_t io_handle = NULL;
    esp_lcd_panel_io_i2c_config_t io_config = {
        .dev_addr = SSD1306_I2C_ADDR,
        .scl_speed_hz = LCD_PIXEL_CLOCK_HZ,
        .control_phase_bytes = 1,
        .lcd_cmd_bits = 8,
        .lcd_param_bits = 8,
        .dc_bit_offset = 6,
    };
    ESP_ERROR_CHECK(esp_lcd_new_panel_io_i2c(bus_handle, &io_config, &io_handle));

    esp_lcd_panel_dev_config_t panel_config = {
        .bits_per_pixel = 1,
        .reset_gpio_num = -1,
    };
    ESP_ERROR_CHECK(esp_lcd_new_panel_ssd1306(io_handle, &panel_config, &panel_handle));

    ESP_ERROR_CHECK(esp_lcd_panel_reset(panel_handle));
    ESP_ERROR_CHECK(esp_lcd_panel_init(panel_handle));
    ESP_ERROR_CHECK(esp_lcd_panel_disp_on_off(panel_handle, true));

    ssd1306_display_clear();
    return ESP_OK;
}

void ssd1306_display_clear(void)
{
    memset(oled_buffer, 0, sizeof(oled_buffer));
}

void ssd1306_display_draw_string_2x(int x, int start_page, const char *str)
{
    while (*str) {
        char c = *str;
        if (c >= 32 && c <= 126) {
            int idx = c - 32;
            for (int col = 0; col < 5; col++) {
                uint8_t font_byte = font_5x8[idx][col];
                uint8_t top_byte = expand_nibble(font_byte & 0x0F);
                uint8_t bottom_byte = expand_nibble((font_byte >> 4) & 0x0F);

                int px = x + (col * 2);
                if (px + 1 < 128) {
                    oled_buffer[start_page * 128 + px]     = top_byte;
                    oled_buffer[start_page * 128 + px + 1] = top_byte;
                    oled_buffer[(start_page + 1) * 128 + px]     = bottom_byte;
                    oled_buffer[(start_page + 1) * 128 + px + 1] = bottom_byte;
                }
            }
        }
        x += 12;
        str++;
    }
}

esp_err_t ssd1306_display_update(void)
{
    if (panel_handle == NULL) {
        return ESP_ERR_INVALID_STATE;
    }
    return esp_lcd_panel_draw_bitmap(panel_handle, 0, 0, 128, 64, oled_buffer);
}